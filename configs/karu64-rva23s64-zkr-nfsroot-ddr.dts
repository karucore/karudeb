/*
 * The RVA23S64 profile board with the Zkr entropy source extension.
 *
 * Use this tree only with a karu64 image built with KARU_ZKR: OpenSBI reads
 * "zkr" here, writes mseccfg and polls the seed CSR, and Linux reads seed
 * for its early randomness. On an image without the CSRs those accesses
 * trap. The tree without "zkr", karu64-rva23s64-nfsroot-ddr.dts, works with
 * every image and is the one to serve if Linux is to leave seed alone.
 *
 * Only the two ISA properties differ; they are restated in full because a
 * device tree source cannot append to a property.
 */
/include/ "karu64-rva23s64-nfsroot-ddr.dts"

&{/cpus/cpu@0} {
	riscv,isa = "rv64imafdcbvh_zicbom_zicbop_zicboz_zicntr_zicond_zicsr_zifencei_zihintntl_zihintpause_zihpm_zimop_zawrs_zfa_zfhmin_zca_zcb_zcmop_zba_zbb_zbs_zkr_zkt_zvbb_zve32f_zve32x_zve64d_zve64f_zve64x_zvfhmin_zvkb_zvkg_zvkned_zvknha_zvknhb_zvksed_zvksh_zvkt_zvl256b_smcntrpmf_smnpm_smstateen_sscofpmf_ssnpm_ssstateen_sstc_svade_svinval_svnapot_svpbmt";
	riscv,isa-extensions = "i", "m", "a", "f", "d", "c", "b", "v", "h",
		"smcntrpmf", "smnpm", "smstateen", "sscofpmf", "ssnpm", "ssstateen",
		"sstc", "svade", "svinval", "svnapot", "svpbmt",
		"zicbom", "zicbop", "zicboz", "zicntr", "zicond", "zicsr", "zifencei",
		"zihintntl", "zihintpause", "zihpm", "zimop", "zawrs", "zfa", "zfhmin",
		"zca", "zcb", "zcmop", "zba", "zbb", "zbs", "zkr", "zkt", "zvbb",
		"zve32f", "zve32x", "zve64d", "zve64f", "zve64x", "zvfhmin",
		"zvkb", "zvkg", "zvkned", "zvknha", "zvknhb", "zvksed", "zvksh",
		"zvkt", "zvl256b";
};
