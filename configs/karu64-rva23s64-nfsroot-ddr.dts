/* Profile selection of the same single-hart VCU118 board and NFS boot path. */
/include/ "karu64-zvk-nfsroot-ddr.dts"

/ {
	model = "karu64 VCU118 DDR RVA23S64 Zvk+Keccak NFS-root";
};

&{/cpus/cpu@0} {
	riscv,isa = "rv64imafdcbvh_zicbom_zicbop_zicboz_zicntr_zicond_zicsr_zifencei_zihintntl_zihintpause_zihpm_zimop_zawrs_zfa_zfhmin_zca_zcb_zcmop_zba_zbb_zbs_zkt_zvbb_zve32f_zve32x_zve64d_zve64f_zve64x_zvfhmin_zvkb_zvkg_zvkned_zvknha_zvknhb_zvksed_zvksh_zvkt_zvl256b_smcntrpmf_smnpm_smstateen_sscofpmf_ssnpm_ssstateen_sstc_svade_svinval_svnapot_svpbmt";
	riscv,isa-extensions = "i", "m", "a", "f", "d", "c", "b", "v", "h",
		"smcntrpmf", "smnpm", "smstateen", "sscofpmf", "ssnpm", "ssstateen",
		"sstc", "svade", "svinval", "svnapot", "svpbmt",
		"zicbom", "zicbop", "zicboz", "zicntr", "zicond", "zicsr", "zifencei",
		"zihintntl", "zihintpause", "zihpm", "zimop", "zawrs", "zfa", "zfhmin",
		"zca", "zcb", "zcmop", "zba", "zbb", "zbs", "zkt", "zvbb",
		"zve32f", "zve32x", "zve64d", "zve64f", "zve64x", "zvfhmin",
		"zvkb", "zvkg", "zvkned", "zvknha", "zvknhb", "zvksed", "zvksh",
		"zvkt", "zvl256b";
	/* PMP is not implemented; do not inherit the legacy board description. */
	/delete-property/ riscv,pmpregions;
	/delete-property/ riscv,pmpgranularity;
};
